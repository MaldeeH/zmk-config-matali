## config/boards/shields/Kconfig.shield
```kconfig
config SHIELD_MATALI_LEFT
    def_bool $(shields_list_contains,matali_left)

config SHIELD_MATALI_RIGHT
    def_bool $(shields_list_contains,matali_right)
```

## config/boards/shields/matali/Kconfig.defconfig
```kconfig
if SHIELD_MATALI_LEFT

config ZMK_KEYBOARD_NAME
    default "Matali"

config ZMK_SPLIT_ROLE_CENTRAL
    default y

config ZMK_SPLIT_BLE_CENTRAL_PERIPHERALS
    default 1

config ZMK_SPLIT_BLE_CENTRAL_BATTERY_LEVEL_FETCHING
    default y

config ZMK_SPLIT_BLE_CENTRAL_BATTERY_LEVEL_PROXY
    default y

endif

if SHIELD_MATALI_LEFT || SHIELD_MATALI_RIGHT

config ZMK_SPLIT
    default y

endif
```
